## app/boards/arm/nrf52840_mdk_dongle/Kconfig.board
```kconfig
# nice!nano board configuration

# Copyright (c) 2020 Pete Johanson
# SPDX-License-Identifier: MIT

config BOARD_NRF52840_MDK_DONGLE
	bool "nrf52840_mdk_dongle"
	depends on SOC_NRF52840_QIAA
```

## app/boards/arm/nrf52840_mdk_dongle/Kconfig.defconfig
```kconfig
# Copyright (c) 2020 Pete Johanson
# SPDX-License-Identifier: MIT

if BOARD_NRF52840_MDK_DONGLE

config BOARD
	default "nrf52840_mdk_dongle"

if USB

config USB_NRFX
	default y

config USB_DEVICE_STACK
	default y

endif # USB

config BT_CTLR
	default BT

config ZMK_BLE
	default y

config ZMK_USB
	default y

config ZMK_BATTERY_VOLTAGE_DIVIDER
	default n

endif # BOARD_NICE_NANO
```

## app/boards/arm/retic1337_tkl/Kconfig.defconfig
```kconfig
# retic1337_tkl board configuration

if BOARD_RETIC1337_TKL

config I2C
	default y

config USB_NRFX
	default y

config USB_DEVICE_STACK
	default y

config BT_CTLR
	default BT

endif # BOARD_RETIC1337_TKL
```
